## src/configs/uz801_defconfig
```kconfig
# Target Architecture
BR2_aarch64=y
BR2_cortex_a53=y

# Toolchain — pre-built glibc, satisfies NetworkManager's requirements
BR2_TOOLCHAIN_EXTERNAL=y
BR2_TOOLCHAIN_EXTERNAL_ARM_AARCH64=y

# System Configuration
BR2_TARGET_GENERIC_HOSTNAME="uz801"
BR2_TARGET_GENERIC_ISSUE="Welcome to Buildroot on UZ801"

# Board overlay and kernel config fragment
BR2_ROOTFS_OVERLAY="board/uz801/rootfs-overlay"
BR2_PACKAGE_BUSYBOX_CONFIG_FRAGMENT_FILES="board/uz801/busybox-extras.config"
BR2_ROOTFS_POST_BUILD_SCRIPT="board/uz801/post-build.sh"
BR2_LINUX_KERNEL_CONFIG_FRAGMENT_FILES="board/uz801/linux.config"

# Linux Kernel (MSM8916 Community Mainline Tree)
BR2_LINUX_KERNEL=y
BR2_LINUX_KERNEL_CUSTOM_GIT=y
BR2_LINUX_KERNEL_CUSTOM_REPO_URL="https://github.com/msm8916-mainline/linux.git"
BR2_LINUX_KERNEL_CUSTOM_REPO_VERSION="wip/msm8916/7.0"
BR2_LINUX_KERNEL_DEFCONFIG="msm8916"
BR2_LINUX_KERNEL_DTS_SUPPORT=y
BR2_LINUX_KERNEL_INTREE_DTS_NAME="qcom/msm8916-yiming-uz801v3"

# Filesystem Output
BR2_TARGET_ROOTFS_EXT2=y
BR2_TARGET_ROOTFS_EXT2_4=y
BR2_TARGET_ROOTFS_EXT2_SIZE="512M"

# Use eudev for /dev management (required by eudev package and networkManager)
BR2_ROOTFS_DEVICE_CREATION_DYNAMIC_EUDEV=y
BR2_PACKAGE_EUDEV=y

# NetworkManager
BR2_PACKAGE_NETWORK_MANAGER=y
BR2_PACKAGE_NETWORK_MANAGER_CLI=y

# WiFi backend: wpa_supplicant with nl80211 + AP mode + D-Bus
BR2_PACKAGE_WPA_SUPPLICANT=y
BR2_PACKAGE_WPA_SUPPLICANT_NL80211=y
BR2_PACKAGE_WPA_SUPPLICANT_AP_SUPPORT=y
BR2_PACKAGE_WPA_SUPPLICANT_DBUS=y

# dnsmasq
BR2_PACKAGE_DNSMASQ=y

# SSH
BR2_PACKAGE_DROPBEAR=y

# Wireless
BR2_PACKAGE_WIRELESS_REGDB=y
BR2_PACKAGE_IW=y

# iptables
BR2_PACKAGE_IPTABLES=y

# LTE / QMI / ModemManager
BR2_PACKAGE_UQMI=y
BR2_PACKAGE_LIBQRTR_GLIB=y
BR2_PACKAGE_LIBQRTR=y
BR2_PACKAGE_XZ=y
BR2_PACKAGE_MODEM_MANAGER=y
BR2_PACKAGE_MODEM_MANAGER_LIBQMI=y
BR2_PACKAGE_MODEM_MANAGER_LIBQRTR=y
BR2_PACKAGE_NETWORK_MANAGER_MODEM_MANAGER=y
BR2_PACKAGE_RMTFS=y
BR2_PACKAGE_PD_MAPPER=y
BR2_PACKAGE_LIBUSBGX=y
BR2_PACKAGE_GT=y

# WireGuard stuff
BR2_PACKAGE_WIREGUARD_TOOLS=y
BR2_PACKAGE_IPROUTE2=y

# Host Utilities
BR2_PACKAGE_HOST_MKBOOTIMG=y
```

## src/package/gt/Config.in
```kconfig
config BR2_PACKAGE_GT
	bool "gt (gadget-tool)"
	depends on BR2_TOOLCHAIN_HAS_THREADS
	select BR2_PACKAGE_LIBUSBGX
	help
	  Gadget-tool - Linux command line tool for setting USB gadget using configFS

	  https://github.com/linux-usb-gadgets/gt
```

## src/package/libqrtr/Config.in
```kconfig
config BR2_PACKAGE_LIBQRTR
	bool "libqrtr"
	help
	  Userspace reference for net/qrtr in the Linux kernel

	  https://github.com/linux-msm/qrtr
```

## src/package/pd-mapper/Config.in
```kconfig
config BR2_PACKAGE_PD_MAPPER
	bool "pd-mapper"
	help
	  pd-mapper - protection domain remapping daemon

	  https://github.com/linux-msm/pd-mapper
```

## src/package/rmtfs/Config.in
```kconfig
config BR2_PACKAGE_RMTFS
	bool "rmtfs"
	help
	  Qualcomm Remote Filesystem Service Implementation

	  https://github.com/linux-msm/rmtfs
```
